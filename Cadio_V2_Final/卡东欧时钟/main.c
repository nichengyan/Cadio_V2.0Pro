#define 	MAIN_Fosc		40000000L	//定义主时钟
#include    "TYPE.h"
#include    "oled.h"
#include    "Key.h"
#include    <stdlib.h>
#include    <stdio.h>
#include    "Gui.h"
#include    "BM8563.h"
#include    "ADC.h"
#include    "UART.h"
#include    "D18B20.h"
#define pi 3.1415926
/*--------------------------------------------------------------------------
Cadio Clock
Demo For RTC (BM8563)
CopyRight (c) 2024~2024 NCY
All rights reserved.

--------------------------------------------------------------------------*/

code uint8_t Weekday_Large[][24*48]={
{
/*--  调入了一幅图像：C:\Users\nist\Desktop\素材\Sunday.bmp  --*/
/*--  宽度x高度=48x24  --*/
0xFF,0x3F,0x3F,0x1F,0xDF,0xDF,0xDF,0x9F,0x1F,0x1F,0x1F,0xFF,0xFF,0xFF,0xFF,0xFF,
0xFF,0xFF,0xFF,0xFF,0xFF,0xFF,0xFF,0xFF,0xFF,0xFF,0xFF,0xFF,0xFF,0xFF,0xFF,0xFF,
0xFF,0xFF,0xFF,0xFF,0xFF,0xFF,0xFF,0xFF,0xFF,0xFF,0xFF,0xFF,0xFF,0xFF,0xFF,0xFF,
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0xE0,0xE0,0xE0,0xFF,0xFF,0xFF,0xFF,0xFF,0xFF,0xFF,0xFF,0xFF,0xFF,0xFF,0xFF,0xFF
},
{
/*--  调入了一幅图像：C:\Users\nist\Desktop\素材\Monday.bmp  --*/
/*--  宽度x高度=48x24  --*/
0xDF,0x1F,0x1F,0x1F,0xFF,0xFF,0xFF,0x7F,0x1F,0x1F,0x1F,0xFF,0xFF,0xFF,0xFF,0xFF,
0xFF,0xFF,0xFF,0xFF,0xFF,0xFF,0xFF,0xFF,0xFF,0xFF,0xFF,0xFF,0xFF,0xFF,0xFF,0xFF,
0xFF,0xFF,0xFF,0xFF,0xFF,0xFF,0xFF,0xFF,0xFF,0xFF,0xFF,0xFF,0xFF,0xFF,0xFF,0xFF,
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0xE0,0xE0,0xE0,0xFF,0xFF,0xFF,0xFF,0xFF,0xFF,0xFF,0xFF,0xFF,0xFF,0xFF,0xFF,0xFF
},
{
/*--  调入了一幅图像：C:\Users\nist\Desktop\素材\Tuesday.bmp  --*/
/*--  宽度x高度=48x24  --*/
0x3F,0x1F,0x1F,0xDF,0x1F,0x1F,0x1F,0xDF,0xDF,0x1F,0x1F,0xFF,0xFF,0xFF,0xFF,0xFF,
0xFF,0xFF,0xFF,0xFF,0xFF,0xFF,0xFF,0xFF,0xFF,0xFF,0xFF,0xFF,0xFF,0xFF,0xFF,0xFF,
0xFF,0xFF,0xFF,0xFF,0xFF,0xFF,0xFF,0xFF,0xFF,0xFF,0xFF,0xFF,0xFF,0xFF,0xFF,0xFF,
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0xE7,0xF3,0xFB,0xFF,0xFF,0xFF,0xFF,0xFF,0xFF,0xFF,0xFF,0xFF,0xFF,0xFF,0xFF,0xFF
},
{
/*--  调入了一幅图像：C:\Users\nist\Desktop\素材\Wednesday.bmp  --*/
/*--  宽度x高度=48x24  --*/
0x1F,0x1F,0x1F,0xDF,0xDF,0x1F,0x1F,0x1F,0xDF,0x1F,0x1F,0xFF,0xFF,0xFF,0xFF,0xFF,
0xFF,0xFF,0xFF,0xFF,0xFF,0xFF,0xFF,0xFF,0xFF,0xFF,0xFF,0xFF,0xFF,0xFF,0xDF,0xDF,
0x1F,0x0F,0x0F,0xFF,0xFF,0xFF,0xFF,0xFF,0xFF,0xFF,0xFF,0xFF,0xFF,0xFF,0xFF,0xFF,
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0xE0,0xE0,0xF0,0xFF,0xFF,0xFF,0xFF,0xFF,0xFF,0xFF,0xFF,0xFF,0xFF,0xFF,0xFF,0xFF
},
{
/*--  调入了一幅图像：C:\Users\nist\Desktop\素材\Thursday.bmp  --*/
/*--  宽度x高度=48x24  --*/
0x3F,0x1F,0x1F,0xDF,0x1F,0x1F,0x1F,0xDF,0xDF,0x1F,0x1F,0xFF,0xDF,0x1F,0x0F,0x0F,
0xFF,0xFF,0xFF,0xFF,0xFF,0xFF,0xFF,0xFF,0xFF,0xFF,0xFF,0xFF,0xFF,0xFF,0xFF,0xFF,
0xFF,0xFF,0xFF,0xFF,0xFF,0xFF,0xFF,0xFF,0xFF,0xFF,0xFF,0xFF,0xFF,0xFF,0xFF,0xFF,
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0xE0,0xE0,0xF0,0xFF,0xEF,0xEF,0xEF,0xE0,0xE0,0xE0,0xEF,0xEF,0xEF,0xFF,0xFF,0xFF
},
{
/*--  调入了一幅图像：C:\Users\nist\Desktop\素材\Friday.bmp  --*/
/*--  宽度x高度=48x24  --*/
0xDF,0x1F,0x1F,0x1F,0xDF,0xDF,0xDF,0xDF,0x9F,0x1F,0x1F,0xFF,0xFF,0xFF,0xFF,0xFF,
0xFF,0xFF,0xFF,0xFF,0xFF,0xFF,0xFF,0xFF,0xFF,0xFF,0xFF,0xFF,0x9F,0x9F,0x9F,0x9F,
0xFF,0xFF,0xFF,0xFF,0xFF,0xFF,0xFF,0xFF,0xFF,0xFF,0xFF,0xFF,0xFF,0xFF,0xFF,0xFF,
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0xEF,0xEF,0xFF,0xFF,0xFF,0xFF,0xFF,0xFF,0xFF,0xFF,0xFF,0xFF,0xFF,0xFF,0xFF,0xFF
},
{
/*--  调入了一幅图像：C:\Users\nist\Desktop\素材\Saturday.bmp  --*/
/*--  宽度x高度=48x24  --*/
0xFF,0x3F,0x3F,0x1F,0xDF,0xDF,0xDF,0x9F,0x1F,0x1F,0x1F,0xFF,0xFF,0xFF,0xFF,0xFF,
0xFF,0xFF,0xFF,0xFF,0xFF,0xFF,0xFF,0xFF,0xFF,0xFF,0xFF,0xFF,0x3F,0x3F,0xFF,0xFF,
0xFF,0xFF,0xFF,0xFF,0xFF,0xFF,0xFF,0xFF,0xFF,0xFF,0xFF,0xFF,0xFF,0xFF,0xFF,0xFF,
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0xE7,0xE3,0xF3,0xFF,0xFF,0xFF,0xFF,0xFF,0xFF,0xFF,0xFF,0xFF,0xFF,0xFF,0xFF,0xFF
}
};


code uint8_t Num_Small[][12*24]={
{
/*--  文字:  0  --*/
/*--  DigifaceWide18;  此字体下对应的点阵为：宽x高=12x24   --*/
0xFF,0xFF,0x3F,0x1F,0x1F,0xDF,0xDF,0x1F,0x1F,0x3F,0xFF,0xFF,0x87,0x00,0x00,0x00,
0xFF,0xFF,0xFF,0xFF,0x00,0x00,0x00,0xFF,0xFF,0xFC,0xF0,0xE0,0xE3,0xEF,0xEF,0xE3,
0xE0,0xF0,0xFC,0xFF
},
{
/*--  文字:  1  --*/
/*--  DigifaceWide18;  此字体下对应的点阵为：宽x高=12x24   --*/
0xFF,0xFF,0x7F,0x7F,0x7F,0x3F,0x1F,0x1F,0xFF,0xFF,0xFF,0xFF,0xFF,0xFF,0xFF,0xFF,
0xFF,0x00,0x00,0x00,0xFF,0xFF,0xFF,0xFF,0xFF,0xFF,0xEF,0xEF,0xE7,0xE0,0xE0,0xE0,
0xEF,0xEF,0xFF,0xFF
},
{
/*--  文字:  2  --*/
/*--  DigifaceWide18;  此字体下对应的点阵为：宽x高=12x24   --*/
0xFF,0x7F,0x3F,0x1F,0x9F,0xDF,0xDF,0x9F,0x1F,0x3F,0x7F,0xFF,0xFF,0xFC,0xFC,0xFC,
0x7F,0x3F,0x1F,0x87,0xC0,0xE0,0xF8,0xFF,0xE7,0xE3,0xE1,0xE4,0xE6,0xE7,0xE7,0xE7,
0xE3,0xE0,0xE0,0xFF
},
{
/*--  文字:  3  --*/
/*--  DigifaceWide18;  此字体下对应的点阵为：宽x高=12x24   --*/
0xFF,0x7F,0x3F,0x1F,0xDF,0xDF,0x9F,0x1F,0x1F,0x3F,0xFF,0xFF,0xFF,0xFC,0xFC,0xFC,
0xEF,0xEF,0xE7,0xC0,0x10,0x18,0x3C,0xFF,0xFF,0xF0,0xF0,0xE0,0xE7,0xEF,0xEF,0xE7,
0xE0,0xF0,0xF8,0xFF
},
{
/*--  文字:  4  --*/
/*--  DigifaceWide18;  此字体下对应的点阵为：宽x高=12x24   --*/
0xFF,0xFF,0xFF,0xFF,0xFF,0x7F,0x1F,0x0F,0x0F,0xFF,0xFF,0xFF,0x7F,0x1F,0x07,0x43,
0x70,0x7C,0x00,0x00,0x00,0x7F,0x7F,0xFF,0xFF,0xFF,0xFF,0xFF,0xEF,0xEF,0xE0,0xE0,
0xE0,0xE7,0xEF,0xFF
},
{
/*--  文字:  5  --*/
/*--  DigifaceWide18;  此字体下对应的点阵为：宽x高=12x24   --*/
0xFF,0xFF,0x1F,0x1F,0x9F,0x9F,0x9F,0x9F,0x9F,0x9F,0x9F,0xFF,0xFF,0xCF,0xC0,0xC0,
0xE7,0xF7,0xF7,0xE7,0x07,0x0F,0x1F,0xFF,0xFF,0xF0,0xF0,0xE0,0xEF,0xEF,0xEF,0xE7,
0xE0,0xF0,0xF8,0xFF
},
{
/*--  文字:  6  --*/
/*--  DigifaceWide18;  此字体下对应的点阵为：宽x高=12x24   --*/
0xFF,0xFF,0x7F,0x3F,0x1F,0x9F,0xDF,0x1F,0x1F,0x1F,0xFF,0xFF,0x07,0x00,0x00,0x00,
0xE7,0xF7,0xF7,0xE7,0x07,0x0F,0x1F,0xFF,0xFF,0xF8,0xF0,0xE0,0xE7,0xEF,0xEF,0xE7,
0xE0,0xF0,0xF8,0xFF
},
{
/*--  文字:  7  --*/
/*--  DigifaceWide18;  此字体下对应的点阵为：宽x高=12x24   --*/
0xFF,0x1F,0x1F,0x1F,0x9F,0x9F,0x9F,0x9F,0x1F,0x1F,0x9F,0xFF,0xFF,0xFC,0xFC,0xFF,
0x7F,0x1F,0x07,0xC1,0xF8,0xFE,0xFF,0xFF,0xFF,0xFF,0xFF,0xFF,0xE0,0xE0,0xE0,0xFF,
0xFF,0xFF,0xFF,0xFF
},
{
/*--  文字:  8  --*/
/*--  DigifaceWide18;  此字体下对应的点阵为：宽x高=12x24   --*/
0xFF,0x7F,0x3F,0x1F,0x9F,0xDF,0xDF,0x9F,0x1F,0x3F,0x7F,0xFF,0xFF,0x38,0x10,0x80,
0xC3,0xC7,0xCF,0x87,0x00,0x10,0x38,0xFF,0xFC,0xF0,0xF0,0xE3,0xE7,0xEF,0xEF,0xE7,
0xE0,0xF0,0xF8,0xFF
},
{
/*--  文字:  9  --*/
/*--  DigifaceWide18;  此字体下对应的点阵为：宽x高=12x24   --*/
0xFF,0x7F,0x3F,0x1F,0x9F,0xDF,0xDF,0x9F,0x1F,0x3F,0x7F,0xFF,0xF1,0xC0,0x80,0x80,
0x9F,0xBF,0x9F,0x9F,0x00,0x00,0x00,0xFF,0xFF,0xF3,0xE3,0xE3,0xE3,0xEF,0xE7,0xE1,
0xF0,0xF8,0xFE,0xFF
},
{
/*--  文字:  /  --*/
/*--  DigifaceWide18;  此字体下对应的点阵为：宽x高=12x24   --*/
0xFF,0xFF,0xFF,0xFF,0xFF,0xFF,0xFF,0x7F,0x1F,0x03,0xE3,0xFB,0xFF,0xFF,0xFF,0x7F,
0x1F,0x07,0xC1,0xF0,0xFC,0xFF,0xFF,0xFF,0xBF,0x8F,0x81,0xF0,0xFC,0xFF,0xFF,0xFF,
0xFF,0xFF,0xFF,0xFF
}
};


code uint8_t Num_Large[][26*48]={
{
/*--  文字:  0  --*/
/*--  DigifaceWide26;  此字体下对应的点阵为：宽x高=26x43   --*/
/*--  高度不是8的倍数，现调整为：宽度x高度=26x48  --*/
0xFF,0xFF,0xFF,0xFF,0xFF,0xFF,0xFF,0xFF,0xFF,0xFF,0xFF,0xFF,0xFF,0xFF,0xFF,0xFF,
0xFF,0xFF,0xFF,0xFF,0xFF,0xFF,0xFF,0xFF,0xFF,0xFF,0xFF,0x1F,0x0F,0x0F,0x07,0x07,
0x03,0xE3,0xE3,0xE3,0xE3,0xE3,0xE3,0xE3,0xE3,0xE3,0xE3,0xE3,0x03,0x07,0x07,0x0F,
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0xFF,0xFF,0xFF,0xFF,0xFF,0xFF,0xFF,0xFF,0xFF,0xFF,0xFF,0xFF
},
{
/*--  文字:  1  --*/
/*--  DigifaceWide26;  此字体下对应的点阵为：宽x高=26x43   --*/
/*--  高度不是8的倍数，现调整为：宽度x高度=26x48  --*/
0xFF,0xFF,0xFF,0xFF,0xFF,0xFF,0xFF,0xFF,0xFF,0xFF,0xFF,0xFF,0xFF,0xFF,0xFF,0xFF,
0xFF,0xFF,0xFF,0xFF,0xFF,0xFF,0xFF,0xFF,0xFF,0xFF,0xFF,0xFF,0xFF,0xFF,0xFF,0xFF,
0xFF,0xFF,0xFF,0xFF,0x1F,0x0F,0x07,0x07,0x03,0x03,0xFF,0xFF,0xFF,0xFF,0xFF,0xFF,
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0xFF,0xFF,0xFF,0xFF,0xFF,0xFF,0xFF,0xFF,0xFF,0xFF,0xFF,0xFF
},
{
/*--  文字:  2  --*/
/*--  DigifaceWide26;  此字体下对应的点阵为：宽x高=26x43   --*/
/*--  高度不是8的倍数，现调整为：宽度x高度=26x48  --*/
0xFF,0xFF,0xFF,0xFF,0xFF,0xFF,0xFF,0xFF,0xFF,0xFF,0xFF,0xFF,0xFF,0xFF,0xFF,0xFF,
0xFF,0xFF,0xFF,0xFF,0xFF,0xFF,0xFF,0xFF,0xFF,0xFF,0xFF,0xDF,0xCF,0xCF,0xE7,0xE3,
0xE3,0xE3,0xE3,0xE3,0xE3,0xE3,0xE3,0xE3,0xE3,0xE3,0xE3,0xE3,0x03,0x07,0x07,0x0F,
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0xFF,0xFF,0xFF,0xFF,0xFF,0xFF,0xFF,0xFF,0xFF,0xFF,0xFF,0xFF
},
{
/*--  文字:  3  --*/
/*--  DigifaceWide26;  此字体下对应的点阵为：宽x高=26x43   --*/
/*--  高度不是8的倍数，现调整为：宽度x高度=26x48  --*/
0xFF,0xFF,0xFF,0xFF,0xFF,0xFF,0xFF,0xFF,0xFF,0xFF,0xFF,0xFF,0xFF,0xFF,0xFF,0xFF,
0xFF,0xFF,0xFF,0xFF,0xFF,0xFF,0xFF,0xFF,0xFF,0xFF,0xFB,0xFB,0xF3,0xF3,0xE3,0xE3,
0xE3,0xE3,0xE3,0xE3,0xE3,0xE3,0xE3,0xE3,0xE3,0xE3,0x03,0x03,0x07,0x0F,0x0F,0x1F,
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0xFF,0xFF,0xFF,0xFF,0xFF,0xFF,0xFF,0xFF,0xFF,0xFF,0xFF,0xFF
},
{
/*--  文字:  4  --*/
/*--  DigifaceWide26;  此字体下对应的点阵为：宽x高=26x43   --*/
/*--  高度不是8的倍数，现调整为：宽度x高度=26x48  --*/
0xFF,0xFF,0xFF,0xFF,0xFF,0xFF,0xFF,0xFF,0xFF,0xFF,0xFF,0xFF,0xFF,0xFF,0xFF,0xFF,
0xFF,0xFF,0xFF,0xFF,0xFF,0xFF,0xFF,0xFF,0xFF,0xFF,0xFF,0x03,0x03,0x03,0x07,0x0F,
0x0F,0xFF,0xFF,0xFF,0xFF,0xFF,0xFF,0xFF,0xFF,0xFF,0xFF,0xFF,0x1F,0x0F,0x07,0x07,
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0xFF,0xFF,0xFF,0xFF,0xFF,0xFF,0xFF,0xFF,0xFF,0xFF,0xFF,0xFF
},
{
/*--  文字:  5  --*/
/*--  DigifaceWide26;  此字体下对应的点阵为：宽x高=26x43   --*/
/*--  高度不是8的倍数，现调整为：宽度x高度=26x48  --*/
0xFF,0xFF,0xFF,0xFF,0xFF,0xFF,0xFF,0xFF,0xFF,0xFF,0xFF,0xFF,0xFF,0xFF,0xFF,0xFF,
0xFF,0xFF,0xFF,0xFF,0xFF,0xFF,0xFF,0xFF,0xFF,0xFF,0xFF,0x1F,0x0F,0x0F,0x07,0x03,
0x03,0xE3,0xE3,0xE3,0xE3,0xE3,0xE3,0xE3,0xE3,0xE3,0xE3,0xE3,0xE3,0xE3,0xF3,0xFB,
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0xFF,0xFF,0xFF,0xFF,0xFF,0xFF,0xFF,0xFF,0xFF,0xFF,0xFF,0xFF
},
{
/*--  文字:  6  --*/
/*--  DigifaceWide26;  此字体下对应的点阵为：宽x高=26x43   --*/
/*--  高度不是8的倍数，现调整为：宽度x高度=26x48  --*/
0xFF,0xFF,0xFF,0xFF,0xFF,0xFF,0xFF,0xFF,0xFF,0xFF,0xFF,0xFF,0xFF,0xFF,0xFF,0xFF,
0xFF,0xFF,0xFF,0xFF,0xFF,0xFF,0xFF,0xFF,0xFF,0xFF,0xFF,0x1F,0x0F,0x0F,0x07,0x03,
0x03,0xE3,0xE3,0xE3,0xE3,0xE3,0xE3,0xE3,0xE3,0xE3,0xE3,0xE3,0xE3,0xE3,0xF3,0xFB,
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0xFF,0xFF,0xFF,0xFF,0xFF,0xFF,0xFF,0xFF,0xFF,0xFF,0xFF,0xFF
},
{
/*--  文字:  7  --*/
/*--  DigifaceWide26;  此字体下对应的点阵为：宽x高=26x43   --*/
/*--  高度不是8的倍数，现调整为：宽度x高度=26x48  --*/
0xFF,0xFF,0xFF,0xFF,0xFF,0xFF,0xFF,0xFF,0xFF,0xFF,0xFF,0xFF,0xFF,0xFF,0xFF,0xFF,
0xFF,0xFF,0xFF,0xFF,0xFF,0xFF,0xFF,0xFF,0xFF,0xFF,0xFB,0xF3,0xF3,0xE3,0xE3,0xE3,
0xE3,0xE3,0xE3,0xE3,0xE3,0xE3,0xE3,0xE3,0xE3,0xE3,0x03,0x03,0x03,0x03,0x03,0x03,
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0xFF,0xFF,0xFF,0xFF,0xFF,0xFF,0xFF,0xFF,0xFF,0xFF,0xFF,0xFF
},
{
/*--  文字:  8  --*/
/*--  DigifaceWide26;  此字体下对应的点阵为：宽x高=26x43   --*/
/*--  高度不是8的倍数，现调整为：宽度x高度=26x48  --*/
0xFF,0xFF,0xFF,0xFF,0xFF,0xFF,0xFF,0xFF,0xFF,0xFF,0xFF,0xFF,0xFF,0xFF,0xFF,0xFF,
0xFF,0xFF,0xFF,0xFF,0xFF,0xFF,0xFF,0xFF,0xFF,0xFF,0xFF,0x1F,0x0F,0x0F,0x07,0x07,
0x03,0xE3,0xE3,0xE3,0xE3,0xE3,0xE3,0xE3,0xE3,0xE3,0xE3,0xE3,0x03,0x07,0x07,0x0F,
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0xFF,0xFF,0xFF,0xFF,0xFF,0xFF,0xFF,0xFF,0xFF,0xFF,0xFF,0xFF
},
{
/*--  文字:  9  --*/
/*--  DigifaceWide26;  此字体下对应的点阵为：宽x高=26x43   --*/
/*--  高度不是8的倍数，现调整为：宽度x高度=26x48  --*/
0xFF,0xFF,0xFF,0xFF,0xFF,0xFF,0xFF,0xFF,0xFF,0xFF,0xFF,0xFF,0xFF,0xFF,0xFF,0xFF,
0xFF,0xFF,0xFF,0xFF,0xFF,0xFF,0xFF,0xFF,0xFF,0xFF,0xFF,0x1F,0x0F,0x0F,0x07,0x07,
0x03,0xE3,0xE3,0xE3,0xE3,0xE3,0xE3,0xE3,0xE3,0xE3,0xE3,0xE3,0x03,0x07,0x07,0x0F,
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0xFF,0xFF,0xFF,0xFF,0xFF,0xFF,0xFF,0xFF,0xFF,0xFF,0xFF,0xFF
},
{
/*--  文字:  ：  --*/
/*--  DigifaceWide26;  此字体下对应的点阵为：宽x高=26x43   --*/
/*--  高度不是8的倍数，现调整为：宽度x高度=26x48  --*/
0xFF,0xFF,0xFF,0xFF,0xFF,0xFF,0xFF,0xFF,0xFF,0xFF,0xFF,0xFF,0xFF,0xFF,0xFF,0xFF,
0xFF,0xFF,0xFF,0xFF,0xFF,0xFF,0xFF,0xFF,0xFF,0xFF,0xFF,0xFF,0xFF,0xFF,0xFF,0xFF,
0xFF,0xFF,0xFF,0xFF,0xFF,0xFF,0xFF,0xFF,0xFF,0xFF,0xFF,0xFF,0xFF,0xFF,0xFF,0xFF,
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0xFF,0xFF,0xFF,0xFF,0xFF,0xFF,0xFF,0xFF,0xFF,0xFF,0xFF,0xFF
}
};

uint8_t Degree[]={
/*--  调入了一幅图像：这是您新建的图像  --*/
/*--  宽度x高度=12x16  --*/
0xCF,0xB7,0xB7,0xCF,0xFF,0xFF,0xFF,0x7F,0x7F,0x7F,0xFF,0xFF,0xFF,0xFF,0xFF,0xFF,
0xFF,0xFF,0xC0,0xBF,0xBF,0xBF,0xDE,0xFF
};


sbit Wifi=P2^0;
sbit Audio=P2^1;
sbit laser=P1^3;
sbit light=P1^7;
Page pMain;


void Pause();//防止误按
void delayms(uint16_t t);//毫秒级延迟函数
void MoveTo(float *from,float to,float step);//一次正比模型的滑动，用于UI动画控制
void Clock(Page *pa);//时钟核心函数
uint8_t presstime=0;//'='键按下时间，长按才会进入调表

void main(void)
{   
    P0M0=0x00;
    P0M1=0x00;
    P1M1=0x0f; 
    P1M0=0x40;   //设置为高阻抗
    P2M0=0x37;
    P2M1=0x00;
    P3M0=0x00;
    P3M1=0x00;
    P5M0=0x00;
    P5M1=0x00; 
    Wifi=0;
    Audio=0;
    laser=0;
    light=0;
    OLED_Init();
    OLED_Display_On();
    OLED_ColorTurn(0);
    OLED_Clear();    
    Gui_Init();
    Gui_CreatePage(&pMain,128,64);
    Gui_ClearBufferBit(&pMain,0);
    BM8563_Init();
    Clock(&pMain);
    while(1);
}

void Pause(){while(Key_Scan()!=0xffff);}
void delayms(uint16_t t){
    uint16_t i;
    while(t--) for(i=0;i<600;i++);
}
void MoveTo(float *from,float to,float step){
    (*from)+=(to-(*from))*step;
}
void Clock(Page *pa){
    int i=0,t=10,temperature=0,cnt=0;
    time tnow;
    float theta0,theta1=0,theta2=0,theta3=0,posx=64;
    uint8_t Weekday[][5]={{"Sun \0"},{"Mon \0"},{"Tue \0"},{"Wed \0"},{"Thur\0"},{"Fri \0"},{"Sat \0"}};
    uint8_t Monthday[]={0,31,28,31,30,31,30,31,31,30,31,30,31};
    uint8_t keynum,setmode=0; //setmode  0:走时模式 1:设置模式
    uint8_t optiona=0,optionb=0;//optiona  0:小时 1:分钟
    t=20;
    while(1){
        keynum=Key_Scan()&0x00ff;
        if(keynum==0x3d){
            if(presstime>3){
                setmode=1;
                presstime=0;
            }else{  
                presstime++;
            }   
        }else{
            presstime=0;
        }
        if(setmode){      
            Pause();
            while(1){
                keynum=Key_Scan()&0x00ff;
                if(keynum==0x3d) break; 
                if(keynum==0x48||keynum==0x4a) optiona=!optiona; 
                Gui_DrawBmp(pa,56,2,26,48,Num_Large[10]);
                Gui_DrawBmp(pa,0,8,26,48,Num_Large[tnow.hour/10]);
                Gui_DrawBmp(pa,27,8,26,48,Num_Large[tnow.hour%10]);
                Gui_DrawBmp(pa,72,8,26,48,Num_Large[tnow.min/10]);
                Gui_DrawBmp(pa,100,8,26,48,Num_Large[tnow.min%10]);          
                if(optiona){
                    Gui_DrawRectangleFilled(pa,0,50,50,2,1);
                    if(keynum==0x44)  {if(tnow.hour<23) {tnow.hour++;} else{tnow.hour=0;}}
                    if(keynum==0x49)  {if(tnow.hour!=0) {tnow.hour--;} else{tnow.hour=23;}}
                }else{
                    Gui_DrawRectangleFilled(pa,72,50,50,2,1);
                    if(keynum==0x44)  {if(tnow.min<59) {tnow.min++;} else{tnow.min=0;}}
                    if(keynum==0x49)  {if(tnow.min!=0) {tnow.min--;} else{tnow.min=59;}}                    
                }       
                Gui_Flush(pa);    
                Gui_ClearBufferBit(pa,0);
                delayms(100);
            }
            Pause();
    
            while(1){
                keynum=Key_Scan()&0x00ff;
                if(keynum==0x3d) break; 
                if(keynum==0x4a)  {if(optionb<3) {optionb++;} else{optionb=0;}}
                if(keynum==0x48)  {if(optionb!=0) {optionb--;} else{optionb=3;}}
                Gui_DrawBmp(pa,0,10,12,24,Num_Small[2]);
                Gui_DrawBmp(pa,12,10,12,24,Num_Small[0]);
                Gui_DrawBmp(pa,24,10,12,24,Num_Small[tnow.year/10]);
                Gui_DrawBmp(pa,36,10,12,24,Num_Small[tnow.year%10]);
                Gui_DrawBmp(pa,48,10,12,24,Num_Small[10]);    
                Gui_DrawBmp(pa,60,10,12,24,Num_Small[tnow.month/10]);
                Gui_DrawBmp(pa,72,10,12,24,Num_Small[tnow.month%10]);  
                Gui_DrawBmp(pa,84,10,12,24,Num_Small[10]);  
                Gui_DrawBmp(pa,96,10,12,24,Num_Small[tnow.day/10]);
                Gui_DrawBmp(pa,108,10,12,24,Num_Small[tnow.day%10]);   
                Gui_DrawBmp(pa,40,36,48,24,Weekday_Large[tnow.weekday]); 
                if(optionb==0){
                    Gui_DrawRectangleFilled(pa,0,36,48,2,1);
                    if(keynum==0x44)  {if(tnow.year<99) {tnow.year++;} else{tnow.year=0;}}
                    if(keynum==0x49)  {if(tnow.year!=0) {tnow.year--;} else{tnow.year=99;}}
                }
                if(optionb==1){
                    Gui_DrawRectangleFilled(pa,60,36,24,2,1);
                    if(keynum==0x44)  {if(tnow.month<12) {tnow.month++;} else{tnow.month=1;}}
                    if(keynum==0x49)  {if(tnow.month!=1) {tnow.month--;} else{tnow.month=12;}}                    
                }    
                if(optionb==2){
                    Gui_DrawRectangleFilled(pa,96,36,24,2,1);
                    if((tnow.month==2)&&((tnow.year%4==0&&tnow.year%100!=0)||(tnow.year%400)==0)){//闰年的2月
                        if(keynum==0x44)  {if(tnow.day<29) {tnow.day++;} else{tnow.day=1;}}
                        if(keynum==0x49)  {if(tnow.day!=1) {tnow.day--;} else{tnow.day=29;}}                           
                    }else{
                        if(keynum==0x44)  {if(tnow.day<Monthday[tnow.month]) {tnow.day++;} else{tnow.day=1;}}
                        if(keynum==0x49)  {if(tnow.day!=1) {tnow.day--;} else{tnow.day=Monthday[tnow.month];}}
                    }
                }
                if(optionb==3){
                    Gui_DrawRectangleFilled(pa,40,62,48,2,1);
                    if(keynum==0x44)  {if(tnow.weekday<6) {tnow.weekday++;} else{tnow.weekday=0;}}
                    if(keynum==0x49)  {if(tnow.weekday!=0) {tnow.weekday--;} else{tnow.weekday=6;}}                      
                }
                Gui_Flush(pa);    
                Gui_ClearBufferBit(pa,0);
                delayms(100);
            }
            Pause();
            BM8563_WriteTime(&tnow);
            setmode=0;
        }
        BM8563_ReadTime(&tnow);
        Gui_DrawCircleWired(pa,32,32,31,1);
        Gui_Printf(pa,26,4,1,0,"12");
        Gui_Printf(pa,29,54,1,0,"6");
        Gui_Printf(pa,2,28,1,0,"9");
        Gui_Printf(pa,56,28,1,0,"3");  
        for(i=0;i<12;i++) if(i%3) {theta0=i*pi/6;Gui_DrawLine(pa,32+sin(theta0-pi/2)*27,32-cos(theta0-pi/2)*27,32+sin(theta0-pi/2)*31,32-cos(theta0-pi/2)*31,1);}
        if(t){
            MoveTo(&theta1,tnow.hour*2*pi/12+tnow.min*pi/360,0.4);
            MoveTo(&theta2,tnow.min*2*pi/60+tnow.sec*pi/1800,0.4);
            MoveTo(&theta3,tnow.sec*2*pi/60,0.4);
            t--;
        }else{
            theta1=tnow.hour*2*pi/12+tnow.min*pi/360;
            theta2=tnow.min*2*pi/60+tnow.sec*pi/1800;
            theta3=tnow.sec*2*pi/60;
        }
        Gui_DrawTriangleFilled(pa,32+sin(theta1-pi/2)*2,32-cos(theta1-pi/2)*2,32+sin(theta1+pi/2)*2,32-cos(theta1+pi/2)*2,32+sin(theta1)*16,32-cos(theta1)*16,1);//时针
        Gui_DrawTriangleFilled(pa,32+sin(theta2-pi/2)*2,32-cos(theta2-pi/2)*2,32+sin(theta2+pi/2)*2,32-cos(theta2+pi/2)*2,32+sin(theta2)*24,32-cos(theta2)*24,1);//分针
        Gui_DrawLine(pa,32,32,32+sin(theta3)*28,32-cos(theta3)*28,1);//秒针
        Gui_DrawCircleFilled(pa,32,32,3,1);     
        //Gui_ShowNum(pa,80,0,D18b20_GetTemperature(),3,0,1,0);
        Gui_Printf_OneLine(pa,80+posx,0,1,1,"20%02bd",tnow.year);
        Gui_Printf_OneLine(pa,76+posx,16,1,1,"%02bd-%02bd",tnow.month,tnow.day);
        Gui_Printf_OneLine(pa,80+posx,32,1,1,Weekday[tnow.weekday]);
        Gui_Printf_OneLine(pa,80+posx,32,1,1,Weekday[tnow.weekday]);
        Gui_Printf_OneLine(pa,80+posx,48,1,1,"%.1f",temperature/10.0);
        if(cnt>10) {temperature=D18b20_GetTemperature();cnt=0;}
        cnt++;
        Gui_DrawBmp(pa,112+posx,48,12,16,Degree);
        MoveTo(&posx,0,0.4);
        Gui_Flush(pa);
        Gui_ClearBufferBit(pa,0);      
    }
}