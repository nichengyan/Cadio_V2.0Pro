#define 	MAIN_Fosc		40000000L	//定义主时钟
#include    "TYPE.h"
#include    "oled.h"
#include    "Key.h"
#include    <stdlib.h>
#include    <stdio.h>
#include    "Gui.h"
#include    "BM8563.h"
#include    "ADC.h"
#include    "UART.h"
#define pi 3.1415926
/*--------------------------------------------------------------------------
Cadio GaoKao Count
Demo For RTC DS1302
CopyRight (c) 2024~2024 NCY
All rights reserved.

--------------------------------------------------------------------------*/

code uint8_t Num_Large[][26*48]={
{
/*--  文字:  0  --*/
/*--  DigifaceWide26;  此字体下对应的点阵为：宽x高=26x43   --*/
/*--  高度不是8的倍数，现调整为：宽度x高度=26x48  --*/
0xFF,0xFF,0xFF,0xFF,0xFF,0xFF,0xFF,0xFF,0xFF,0xFF,0xFF,0xFF,0xFF,0xFF,0xFF,0xFF,
0xFF,0xFF,0xFF,0xFF,0xFF,0xFF,0xFF,0xFF,0xFF,0xFF,0xFF,0x1F,0x0F,0x0F,0x07,0x07,
0x03,0xE3,0xE3,0xE3,0xE3,0xE3,0xE3,0xE3,0xE3,0xE3,0xE3,0xE3,0x03,0x07,0x07,0x0F,
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0xFF,0xFF,0xFF,0xFF,0xFF,0xFF,0xFF,0xFF,0xFF,0xFF,0xFF,0xFF
},
{
/*--  文字:  1  --*/
/*--  DigifaceWide26;  此字体下对应的点阵为：宽x高=26x43   --*/
/*--  高度不是8的倍数，现调整为：宽度x高度=26x48  --*/
0xFF,0xFF,0xFF,0xFF,0xFF,0xFF,0xFF,0xFF,0xFF,0xFF,0xFF,0xFF,0xFF,0xFF,0xFF,0xFF,
0xFF,0xFF,0xFF,0xFF,0xFF,0xFF,0xFF,0xFF,0xFF,0xFF,0xFF,0xFF,0xFF,0xFF,0xFF,0xFF,
0xFF,0xFF,0xFF,0xFF,0x1F,0x0F,0x07,0x07,0x03,0x03,0xFF,0xFF,0xFF,0xFF,0xFF,0xFF,
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0xFF,0xFF,0xFF,0xFF,0xFF,0xFF,0xFF,0xFF,0xFF,0xFF,0xFF,0xFF
},
{
/*--  文字:  2  --*/
/*--  DigifaceWide26;  此字体下对应的点阵为：宽x高=26x43   --*/
/*--  高度不是8的倍数，现调整为：宽度x高度=26x48  --*/
0xFF,0xFF,0xFF,0xFF,0xFF,0xFF,0xFF,0xFF,0xFF,0xFF,0xFF,0xFF,0xFF,0xFF,0xFF,0xFF,
0xFF,0xFF,0xFF,0xFF,0xFF,0xFF,0xFF,0xFF,0xFF,0xFF,0xFF,0xDF,0xCF,0xCF,0xE7,0xE3,
0xE3,0xE3,0xE3,0xE3,0xE3,0xE3,0xE3,0xE3,0xE3,0xE3,0xE3,0xE3,0x03,0x07,0x07,0x0F,
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0xFF,0xFF,0xFF,0xFF,0xFF,0xFF,0xFF,0xFF,0xFF,0xFF,0xFF,0xFF
},
{
/*--  文字:  3  --*/
/*--  DigifaceWide26;  此字体下对应的点阵为：宽x高=26x43   --*/
/*--  高度不是8的倍数，现调整为：宽度x高度=26x48  --*/
0xFF,0xFF,0xFF,0xFF,0xFF,0xFF,0xFF,0xFF,0xFF,0xFF,0xFF,0xFF,0xFF,0xFF,0xFF,0xFF,
0xFF,0xFF,0xFF,0xFF,0xFF,0xFF,0xFF,0xFF,0xFF,0xFF,0xFB,0xFB,0xF3,0xF3,0xE3,0xE3,
0xE3,0xE3,0xE3,0xE3,0xE3,0xE3,0xE3,0xE3,0xE3,0xE3,0x03,0x03,0x07,0x0F,0x0F,0x1F,
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0xFF,0xFF,0xFF,0xFF,0xFF,0xFF,0xFF,0xFF,0xFF,0xFF,0xFF,0xFF
},
{
/*--  文字:  4  --*/
/*--  DigifaceWide26;  此字体下对应的点阵为：宽x高=26x43   --*/
/*--  高度不是8的倍数，现调整为：宽度x高度=26x48  --*/
0xFF,0xFF,0xFF,0xFF,0xFF,0xFF,0xFF,0xFF,0xFF,0xFF,0xFF,0xFF,0xFF,0xFF,0xFF,0xFF,
0xFF,0xFF,0xFF,0xFF,0xFF,0xFF,0xFF,0xFF,0xFF,0xFF,0xFF,0x03,0x03,0x03,0x07,0x0F,
0x0F,0xFF,0xFF,0xFF,0xFF,0xFF,0xFF,0xFF,0xFF,0xFF,0xFF,0xFF,0x1F,0x0F,0x07,0x07,
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0xFF,0xFF,0xFF,0xFF,0xFF,0xFF,0xFF,0xFF,0xFF,0xFF,0xFF,0xFF
},
{
/*--  文字:  5  --*/
/*--  DigifaceWide26;  此字体下对应的点阵为：宽x高=26x43   --*/
/*--  高度不是8的倍数，现调整为：宽度x高度=26x48  --*/
0xFF,0xFF,0xFF,0xFF,0xFF,0xFF,0xFF,0xFF,0xFF,0xFF,0xFF,0xFF,0xFF,0xFF,0xFF,0xFF,
0xFF,0xFF,0xFF,0xFF,0xFF,0xFF,0xFF,0xFF,0xFF,0xFF,0xFF,0x1F,0x0F,0x0F,0x07,0x03,
0x03,0xE3,0xE3,0xE3,0xE3,0xE3,0xE3,0xE3,0xE3,0xE3,0xE3,0xE3,0xE3,0xE3,0xF3,0xFB,
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0xFF,0xFF,0xFF,0xFF,0xFF,0xFF,0xFF,0xFF,0xFF,0xFF,0xFF,0xFF
},
{
/*--  文字:  6  --*/
/*--  DigifaceWide26;  此字体下对应的点阵为：宽x高=26x43   --*/
/*--  高度不是8的倍数，现调整为：宽度x高度=26x48  --*/
0xFF,0xFF,0xFF,0xFF,0xFF,0xFF,0xFF,0xFF,0xFF,0xFF,0xFF,0xFF,0xFF,0xFF,0xFF,0xFF,
0xFF,0xFF,0xFF,0xFF,0xFF,0xFF,0xFF,0xFF,0xFF,0xFF,0xFF,0x1F,0x0F,0x0F,0x07,0x03,
0x03,0xE3,0xE3,0xE3,0xE3,0xE3,0xE3,0xE3,0xE3,0xE3,0xE3,0xE3,0xE3,0xE3,0xF3,0xFB,
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0xFF,0xFF,0xFF,0xFF,0xFF,0xFF,0xFF,0xFF,0xFF,0xFF,0xFF,0xFF
},
{
/*--  文字:  7  --*/
/*--  DigifaceWide26;  此字体下对应的点阵为：宽x高=26x43   --*/
/*--  高度不是8的倍数，现调整为：宽度x高度=26x48  --*/
0xFF,0xFF,0xFF,0xFF,0xFF,0xFF,0xFF,0xFF,0xFF,0xFF,0xFF,0xFF,0xFF,0xFF,0xFF,0xFF,
0xFF,0xFF,0xFF,0xFF,0xFF,0xFF,0xFF,0xFF,0xFF,0xFF,0xFB,0xF3,0xF3,0xE3,0xE3,0xE3,
0xE3,0xE3,0xE3,0xE3,0xE3,0xE3,0xE3,0xE3,0xE3,0xE3,0x03,0x03,0x03,0x03,0x03,0x03,
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0xFF,0xFF,0xFF,0xFF,0xFF,0xFF,0xFF,0xFF,0xFF,0xFF,0xFF,0xFF
},
{
/*--  文字:  8  --*/
/*--  DigifaceWide26;  此字体下对应的点阵为：宽x高=26x43   --*/
/*--  高度不是8的倍数，现调整为：宽度x高度=26x48  --*/
0xFF,0xFF,0xFF,0xFF,0xFF,0xFF,0xFF,0xFF,0xFF,0xFF,0xFF,0xFF,0xFF,0xFF,0xFF,0xFF,
0xFF,0xFF,0xFF,0xFF,0xFF,0xFF,0xFF,0xFF,0xFF,0xFF,0xFF,0x1F,0x0F,0x0F,0x07,0x07,
0x03,0xE3,0xE3,0xE3,0xE3,0xE3,0xE3,0xE3,0xE3,0xE3,0xE3,0xE3,0x03,0x07,0x07,0x0F,
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0xFF,0xFF,0xFF,0xFF,0xFF,0xFF,0xFF,0xFF,0xFF,0xFF,0xFF,0xFF
},
{
/*--  文字:  9  --*/
/*--  DigifaceWide26;  此字体下对应的点阵为：宽x高=26x43   --*/
/*--  高度不是8的倍数，现调整为：宽度x高度=26x48  --*/
0xFF,0xFF,0xFF,0xFF,0xFF,0xFF,0xFF,0xFF,0xFF,0xFF,0xFF,0xFF,0xFF,0xFF,0xFF,0xFF,
0xFF,0xFF,0xFF,0xFF,0xFF,0xFF,0xFF,0xFF,0xFF,0xFF,0xFF,0x1F,0x0F,0x0F,0x07,0x07,
0x03,0xE3,0xE3,0xE3,0xE3,0xE3,0xE3,0xE3,0xE3,0xE3,0xE3,0xE3,0x03,0x07,0x07,0x0F,
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0xFF,0xFF,0xFF,0xFF,0xFF,0xFF,0xFF,0xFF,0xFF,0xFF,0xFF,0xFF
}
};
uint8_t Day[]={
/*--  文字:  天  --*/
/*--  DigifaceWide18;  此字体下对应的点阵为：宽x高=24x24   --*/
0xFF,0xFF,0xFF,0xEF,0xEF,0xEF,0xEF,0xEF,0xEF,0xEF,0x0F,0x0F,0x0F,0xEF,0xEF,0xEF,
0xE7,0xE3,0xF3,0xE7,0xEF,0xFF,0xFF,0xFF,0xFF,0xF7,0xF7,0xF7,0xF7,0xF7,0xF7,0xF7,
0x77,0x07,0x00,0x80,0xE0,0x07,0x17,0x77,0xF7,0xF7,0xF3,0xF9,0xF9,0xF3,0xF7,0xFF,
0xFF,0xBF,0xBF,0x9F,0x8F,0xCF,0xE3,0xF1,0xF8,0xFC,0xFE,0xFF,0xFF,0xFF,0xFC,0xF8,
0xF1,0xE3,0xC7,0x87,0x8F,0x8F,0xDF,0xFF

};
sbit Wifi=P2^0;
sbit Audio=P2^1;
sbit laser=P1^3;
sbit light=P1^7;
Page pMain;

const uint8_t Days[]={0,31,28,31,30,31,30,31,31,30,31,30,31};
void Pause();//防止误按
void delayms(uint16_t t);//毫秒级延迟函数
uint8_t tmp;
time tnow;
uint16_t Day_Cnt=0;
uint Day_Left(time tx){
    uint16_t DayCnt=0;
    while(1){
        if(tx.year==25&&tx.month==6&&tx.day==6) return DayCnt;
        if(tx.day>Days[tx.month]){ tx.day=1;tx.month++;}
        if(tx.month>12) {tx.year++;tx.month=1;}
        tx.day++;
        DayCnt++;
    }
}
void main(void)
{   
    P0M0=0x00;
    P0M1=0x00;
    P1M1=0x0e; 
    P1M0=0x40;   //设置为高阻抗
    P2M0=0x37;
    P2M1=0x00;
    P3M0=0x00;
    P3M1=0x00;
    P5M0=0x00;
    P5M1=0x00; 
    Wifi=0;
    Audio=0;
    laser=0;
    light=0;
    OLED_Init();
    OLED_Display_On();
    OLED_ColorTurn(0);
    OLED_Clear();    
    Gui_Init();
    Gui_CreatePage(&pMain,128,64);
    Gui_ClearBufferBit(&pMain,0);
    //DS1302_Init();
    //while(1);
    tnow.year=24;
    tnow.month=9;
    tnow.day=16;
    tnow.mode=1;
    //OLED_ShowNum(0,0,Day_Left(tnow),3,16);
    while(1){
        BM8563_ReadTime(&tnow);
        Day_Cnt=Day_Left(tnow);
        Gui_ClearBufferBit(&pMain,0);
        Gui_DrawBmp(&pMain,0,0,26,48,Num_Large[Day_Cnt/100]);
        Gui_DrawBmp(&pMain,28,0,26,48,Num_Large[(Day_Cnt/10)%10]);
        Gui_DrawBmp(&pMain,56,0,26,48,Num_Large[Day_Cnt%10]);
        Gui_DrawBmp(&pMain,86,12,24,24,Day);
        Gui_Printf(&pMain,0,48,1,1,"%02bd:%02bd:%02bd",23-tnow.hour,59-tnow.min,59-tnow.sec);
        Gui_Flush(&pMain);
    }
}

void Pause(){while(Key_Scan()!=0xffff);}
void delayms(uint16_t t){
    uint16_t i;
    while(t--) for(i=0;i<600;i++);
}
void MoveTo(float *from,float to,float step){
    (*from)+=(to-(*from))*step;
}
